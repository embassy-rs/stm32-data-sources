# STM32N657 register map
File version: 1.0
CPU: CM55 r0p1, little endian, no MPU, FPU, vendor SysTick, 8 interrupt priority bits
Registers are 32-bit, read-write, reset 0x0 unless marked. A register's access mark holds for its fields unless they carry their own. Offsets are from the block's base; lines under a group give offsets from that group; [hi:lo] are bit positions; {n}, {i} and the like mark numbered series; 'fields as' and 'values as' point back to an identical list; <NAME> marks a mode.

## Memory map
0x40000000 TIM2 size 0x3E4 — General-purpose timers
0x40000400 TIM3 size 0x3E4 — General purpose timers
0x40000800 TIM4 size 0x3E4 — General purpose timers
0x40000C00 TIM5 size 0x3E4 — General purpose timers
0x40001000 TIM6 size 0x400 — Basic timers
0x40001400 TIM7 size 0x400 — Basic timers
0x40001800 TIM12 size 0x400 — General-purpose timers
0x40001C00 TIM13 size 0x400 — General-purpose timers
0x40002000 TIM14 size 0x400 — General-purpose timers
0x40002400 LPTIM1 size 0x400 — Low-power timer
0x40002C00 WWDG size 0x400 — System window watchdog
0x40003000 TIM10 size 0x400 — General-purpose timers
0x40003400 TIM11 size 0x400 — General-purpose timers
0x40003800 SPI2 size 0x400
0x40003C00 SPI3 size 0x400
0x40004000 SPDIFRX size 0x1C — SPDIF receiver interface
0x40004400 USART2 size 0x400
0x40004800 USART3 size 0x400
0x40004C00 UART4 size 0x400
0x40005000 UART5 size 0x400
0x40005400 I2C1 size 0x400 — Inter-integrated circuit
0x40005800 I2C2 size 0x400
0x40005C00 I2C3 size 0x400
0x40006000 I3C1 size 0x400 — Improved inter-integrated circuit
0x40006400 I3C2 size 0x400
0x40007800 UART7 size 0x400
0x40007C00 UART8 size 0x400
0x40009400 MDIOS size 0x400 — Management data input/output
0x4000A000 FDCAN1 size 0x304 — FDCAN register block
0x4000A400 FDCAN2 size 0x304
0x4000E800 FDCAN3 size 0x304
0x4000FC00 UCPD size 0x400 — USB Type-C/USB Power Delivery interface
0x40021000 GPDMA size 0x1000 — General purpose direct memory access controller
0x40022000 ADC1 size 0xD4 — Analog-to-digital converters
0x40022100 ADC2 size 0xD4
0x40022300 ADC12 size 0x314 — ADC common registers
0x42000000 TIM1 size 0x400 — Advanced-control timers
0x42000400 TIM8 size 0x400 — Advanced-control timers
0x42001000 USART1 size 0x400 — Universal synchronous/asynchronous receiver transmitter
0x42001400 USART6 size 0x400
0x42001800 UART9 size 0x400
0x42001C00 USART10 size 0x400
0x42003000 SPI1 size 0x400 — Serial peripheral interface
0x42003400 SPI4 size 0x400
0x42003C00 TIM18 size 0x400 — Basic timers
0x42004000 TIM15 size 0x3E4 — General purpose timers
0x42004400 TIM16 size 0x3E4 — General purpose timers
0x42004800 TIM17 size 0x3E4 — General purpose timers
0x42004C00 TIM9 size 0x400 — General-purpose timers
0x42005000 SPI5 size 0x400
0x42005800 SAI1 size 0x400 — Serial audio interface
0x42005C00 SAI2 size 0x400
0x42023000 RAMCFG size 0x1000 — SRAM configuration controller
0x42025000 MDF1 size 0x1000 — MDF register block
0x42026000 ADF size 0x400 — Audio digital filter
0x44001000 DBGMCU size 0x10C — Microcontroller debug unit
0x44020000 RNG size 0x14 — True random number generator
0x44020400 HASH size 0x400 — HASH register bank (full SHA-2/SHA-3)
0x44020800 CRYP size 0x400 — Cryptographic processor
0x44021000 SAES size 0x400 — Secure AES coprocessor
0x44022000 PKA size 0x2000 — Public key accelerator
0x44024000 RIFSC size 0x1000 — Resource isolation framework security controller
0x44025000 IAC size 0x400 — Illegal access controller
0x44026000 RISAF size 0x400 — Resource isolation slave unit for address space protection
0x46000800 HDP size 0x400 — Hardware debug port
0x46000C00 LPUART1 size 0x30 — Low-power universal asynchronous receiver transmitter
0x46001400 SPI6 size 0x400
0x46001C00 I2C4 size 0x400
0x46002400 LPTIM2 size 0x400 — Low-power timer
0x46002800 LPTIM3 size 0x400 — Low-power timer
0x46002C00 LPTIM4 size 0x400 — Low-power timer
0x46003000 LPTIM5 size 0x400 — Low-power timer
0x46003C00 VREFBUF size 0x8 — Voltage reference buffer
0x46004000 RTC size 0x400 — Real-time clock
0x46004400 TAMP size 0x400 — Tamper and backup registers
0x46004800 IWDG size 0x400 — Independent watchdog
0x46008000 SYSCFG size 0x1000 — System configuration controller
0x46009000 BSEC size 0x1000 — Boot and security control
0x4600A000 DTS size 0x130 — Digital temperature sensor
0x46020000 GPIOA size 0x400 — General-purpose I/Os
0x46020400 GPIOB size 0x400 — General-purpose I/Os
0x46020800 GPIOC size 0x400 — General-purpose I/Os
0x46020C00 GPIOD size 0x400 — General-purpose I/Os
0x46021000 GPIOE size 0x400 — General-purpose I/Os
0x46021400 GPIOF size 0x400 — General-purpose I/Os
0x46021800 GPIOG size 0x400 — General-purpose I/Os
0x46021C00 GPIOH size 0x400 — General-purpose I/Os
0x46023400 GPION size 0x400 — General-purpose I/Os
0x46023800 GPIOO size 0x400 — General-purpose I/Os
0x46023C00 GPIOP size 0x400 — General-purpose I/Os
0x46024000 GPIOQ size 0x400 — General-purpose I/Os
0x46024800 PWR size 0x400 — Power control
0x46024C00 CRC size 0x18 — Cyclic redundancy check calculation unit
0x46025000 EXTI size 0xA8 — Extended interrupts and event controller
0x46028000 RCC size 0x1D00 — Reset and clock control
0x48001000 LTDC size 0x27C — LCD-TFT display controller
0x48002000 DCMIPP size 0x1000 — Digital camera interface pixel pipeline
0x48004000 GFXTIM size 0x1000 — Graphic timer
0x48005000 VENC size 0x1000 — Video encoder
0x48006000 CSI size 0x2000 — CSI-2 Host
0x48020000 HPDMA size 0x1000 — High-performance direct memory access controller
0x48021000 DMA2D size 0xC00 — Chrom-ART Accelerator controller
0x48023000 JPEG size 0x800 — JPEG codec
0x48024000 FMC1 size 0x400 — Flexible memory controller
0x48025000 XSPI1 size 0x1000 — Extended-SPI interface
0x48026400 PSSI size 0x400 — Parallel synchronous slave interface
0x48026800 SDMMC2 size 0x400
0x48026C00 DLYBSD2 size 0x8
0x48027000 SDMMC1 size 0x400 — Secure digital input/output MultiMediaCard interface
0x48028000 DLYBSD size 0x8 — DLYBSD address block description
0x48028400 DCMI size 0x2C — Digital camera interface
0x4802A000 XSPI2 size 0x1000
0x4802B400 XSPIM size 0x4C — XSPI I/O manager
0x4802B800 MCE1 size 0x28C — Memory cipher engine
0x4802BC00 MCE2 size 0x28C
0x4802C000 MCE3 size 0x28C
0x4802D000 XSPI3 size 0x1000
0x4802E000 MCE4 size 0x28C
0x48030000 GFXMMU size 0x3000 — Chrom-GRC
0x48035000 ICACHE size 0x400 — Texture cache
0x48036000 ETH size 0x11E8 — Ethernet address block description
0x48040000 OTG1 size 0xE08 — USB on-the-go high-speed
0x48080000 OTG2 size 0xE08
0x480DFC00 CACHEAXI size 0x400 — AXI cache
0x50000000 TIM2_S size 0x3E4
0x50000400 TIM3_S size 0x3E4
0x50000800 TIM4_S size 0x3E4
0x50000C00 TIM5_S size 0x3E4
0x50001000 TIM6_S size 0x400
0x50001400 TIM7_S size 0x400
0x50001800 TIM12_S size 0x400
0x50001C00 TIM13_S size 0x400
0x50002000 TIM14_S size 0x400
0x50002400 LPTIM1_S size 0x400
0x50002C00 WWDG_S size 0x400
0x50003000 TIM10_S size 0x400
0x50003400 TIM11_S size 0x400
0x50003800 SPI2_S size 0x400
0x50003C00 SPI3_S size 0x400
0x50004000 SPDIFRX_S size 0x1C
0x50004400 USART2_S size 0x400
0x50004800 USART3_S size 0x400
0x50004C00 UART4_S size 0x400
0x50005000 UART5_S size 0x400
0x50005400 I2C1_S size 0x400
0x50005800 I2C2_S size 0x400
0x50005C00 I2C3_S size 0x400
0x50006000 I3C1_S size 0x400
0x50006400 I3C2_S size 0x400
0x50007800 UART7_S size 0x400
0x50007C00 UART8_S size 0x400
0x50009400 MDIOS_S size 0x400
0x5000A000 FDCAN1_S size 0x304
0x5000A400 FDCAN2_S size 0x304
0x5000E800 FDCAN3_S size 0x304
0x5000FC00 UCPD_S size 0x400
0x50021000 GPDMA_S size 0x1000
0x50022000 ADC1_S size 0xD4
0x50022100 ADC2_S size 0xD4
0x50022300 ADC12_S size 0x314
0x52000000 TIM1_S size 0x400
0x52000400 TIM8_S size 0x400
0x52001000 USART1_S size 0x400
0x52001400 USART6_S size 0x400
0x52001800 UART9_S size 0x400
0x52001C00 USART10_S size 0x400
0x52003000 SPI1_S size 0x400
0x52003400 SPI4_S size 0x400
0x52003C00 TIM18_S size 0x400
0x52004000 TIM15_S size 0x3E4
0x52004400 TIM16_S size 0x3E4
0x52004800 TIM17_S size 0x3E4
0x52004C00 TIM9_S size 0x400
0x52005000 SPI5_S size 0x400
0x52005800 SAI1_S size 0x400
0x52005C00 SAI2_S size 0x400
0x52023000 RAMCFG_S size 0x1000
0x52025000 MDF1_S size 0x1000
0x52026000 ADF_S size 0x400
0x54001000 DBGMCU_S size 0x10C
0x54020000 RNG_S size 0x14
0x54020400 HASH_S size 0x400
0x54020800 CRYP_S size 0x400
0x54021000 SAES_S size 0x400
0x54022000 PKA_S size 0x2000
0x54024000 RIFSC_S size 0x1000
0x54025000 IAC_S size 0x400
0x54026000 RISAF_S size 0x400
0x56000800 HDP_S size 0x400
0x56000C00 LPUART1_S size 0x30
0x56001400 SPI6_S size 0x400
0x56001C00 I2C4_S size 0x400
0x56002400 LPTIM2_S size 0x400
0x56002800 LPTIM3_S size 0x400
0x56002C00 LPTIM4_S size 0x400
0x56003000 LPTIM5_S size 0x400
0x56003C00 VREFBUF_S size 0x8
0x56004000 RTC_S size 0x400
0x56004400 TAMP_S size 0x400
0x56004800 IWDG_S size 0x400
0x56008000 SYSCFG_S size 0x1000
0x56009000 BSEC_S size 0x1000
0x5600A000 DTS_S size 0x130
0x56020000 GPIOA_S size 0x400
0x56020400 GPIOB_S size 0x400
0x56020800 GPIOC_S size 0x400
0x56020C00 GPIOD_S size 0x400
0x56021000 GPIOE_S size 0x400
0x56021400 GPIOF_S size 0x400
0x56021800 GPIOG_S size 0x400
0x56021C00 GPIOH_S size 0x400
0x56023400 GPION_S size 0x400
0x56023800 GPIOO_S size 0x400
0x56023C00 GPIOP_S size 0x400
0x56024000 GPIOQ_S size 0x400
0x56024800 PWR_S size 0x400
0x56024C00 CRC_S size 0x18
0x56025000 EXTI_S size 0xA8
0x56028000 RCC_S size 0x1D00
0x58001000 LTDC_S size 0x27C
0x58002000 DCMIPP_S size 0x1000
0x58004000 GFXTIM_S size 0x1000
0x58005000 VENC_S size 0x1000
0x58006000 CSI_S size 0x2000
0x58020000 HPDMA_S size 0x1000
0x58021000 DMA2D_S size 0xC00
0x58023000 JPEG_S size 0x800
0x58024000 FMC1_S size 0x400
0x58025000 XSPI1_S size 0x1000
0x58026400 PSSI_S size 0x400
0x58026800 SDMMC2_S size 0x400
0x58026C00 DLYBSD2_S size 0x8
0x58027000 SDMMC1_S size 0x400
0x58028000 DLYBSD_S size 0x8
0x58028400 DCMI_S size 0x2C
0x5802A000 XSPI2_S size 0x1000
0x5802B400 XSPIM_S size 0x4C
0x5802B800 MCE1_S size 0x28C
0x5802BC00 MCE2_S size 0x28C
0x5802C000 MCE3_S size 0x28C
0x5802D000 XSPI3_S size 0x1000
0x5802E000 MCE4_S size 0x28C
0x58030000 GFXMMU_S size 0x3000
0x58035000 ICACHE_S size 0x400
0x58036000 ETH_S size 0x11E8
0x58040000 OTG1_S size 0xE08
0x58080000 OTG2_S size 0xE08
0x580DFC00 CACHEAXI_S size 0x400

## Interrupts
0 PVD_PVM (EXTI) — PVDOUT through the EXTI line
2 DTS — Thermal sensor interruption
3 RCC — RCC global interrupt
4 LOCKUP (EXTI) — LOCKUP - no overstack in Cortex-M55
5 CACHE_ECC (EXTI) — Cache ECC error
6 TCM_ECC (EXTI) — TCM ECC error
7 BCK_ECC (EXTI) — Backup RAM interrupts (SEC and DED)
8 FPU (EXTI) — FPU safety flag
10 RTC_S — RTC secure interrupt
11 TAMP — TAMP secure and non-secure synchronous interrupt line
12 RIFSC_TAMPER (RIFSC) — RIF can generate an interrupt when a laser attack is detected
13 IAC — IAC global interrupt
14 RCC_S — RCC global secure interrupt
16 RTC — RTC interrupt
18 WDGLS_EARLY (WWDG) — Independent watchdog interrupt
19 WWDG_EARLY (WWDG) — Window watchdog interrupt
{n+20} EXTI{n} (EXTI) (n=0..8) — EXTI Line {n} interrupt through the EXTI line
29 EXTI9 (EXTI) — EXTI Line 9 interrupt
30 EXTI10 (EXTI) — EXTI Line 10 interrupt
31 EXTI11 (EXTI) — EXTI Line 11 interrupt
32 EXTI12 (EXTI) — EXTI Line 12 interrupt
33 EXTI13 (EXTI) — EXTI Line 13 interrupt
34 EXTI14 (EXTI) — EXTI Line 14 interrupt
35 EXTI15 (EXTI) — EXTI Line 15 interrupt
36 SAES — SAES global interrupt
37 CRYP — CRYP global interrupt
38 PKA — PKA global interrupt
39 HASH — HASH global interrupt
40 RNG — RNG global interrupt
42 MCE1 — MCE1 global interrupt
43 MCE2 — MCE2 global interrupt
44 MCE3 — MCE3 global interrupt
45 MCE4 — MCE4 global interrupt
46 ADC12 — ADC1/ADC2 global interrupt
47 CSI_DBG (CSI) — CSI global interrupt
48 DCMIPP — DCMIPP global interrupt
52 PAHB_ERR (EXTI) — Write posting errors on Cortex-M55 PAHB interface
53 NPU_end_of_epoch (EXTI) — NPU mst_ints[0] line
54 NPU1 (EXTI) — NPU mst_ints[1] line
55 NPU2 (EXTI) — NPU mst_ints[2] line
56 NPU3 (EXTI) — NPU mst_ints[3] line
57 NPUCACHE (EXTI) — ATON interrupt cache
58 LTDC_LO (LTDC) — LCD low-layer global interrupt
59 LTDC_LO_ERR (LTDC) — LCD low-layer error interrupt
60 DMA2D — DMA2D global interrupt
61 JPEG — JPEG global interrupt
62 VENC — VENC global interrupt
63 GFXMMU — GFXMMU global interrupt
64 GFXTIM — GFXTIM global interrupt
65 GPU2D (LTDC) — GPU2D global interrupt
66 GPU2D_ERROR (LTDC) — GPU2D global interrupt
67 GPU_CACHE (LTDC) — GPU cache interrupt
{n+68} HPDMA1_CH{n} (HPDMA) (n=0..15) — HPDMA1 Channel {n} interrupt
{n+84} GPDMA1_CH{n} (GPDMA) (n=0..15) — GPDMA1 channel {n} interrupt
100 I2C1_EV (I2C1) — I2C1 event interrupt
101 I2C1_ER (I2C1) — I2C1 error interrupt
102 I2C2_EV (I2C2) — I2C2 event interrupt
103 I2C2_ER (I2C2) — I2C2 error interrupt
104 I2C3_EV (I2C3) — I2C3 event interrupt
105 I2C3_ER (I2C3) — I2C3 error interrupt
106 I2C4_EV (I2C4) — I2C4 event interrupt
107 I2C4_ER (I2C4) — I2C4 error interrupt
108 I3C1_EV (I3C1) — I3C1 event interrupt
109 I3C1_ER (I3C1) — I3C1 error interrupt
110 I3C2_EV (I3C2) — I3C2 event interrupt
111 I3C2_ER (I3C2) — I3C2 error interrupt
112 TIM1_BRK (TIM1) — TIM1 Break interrupt
113 TIM1_UP (TIM1) — TIM1 Update interrupt
114 TIM1_TRG_CCU (TIM1) — TIM1 Trigger and Commutation interrupts
115 TIM1_CC (TIM1) — TIM1 Capture Compare interrupt
116 TIM2 — TIM2 global interrupt
117 TIM3 — TIM3 global interrupt
118 TIM4 — TIM4 global interrupt
119 TIM5 — TIM5 global interrupt
120 TIM6 — TIM6 Global interrupt
121 TIM7 — TIM7 Global interrupt
122 TIM8_BRK (TIM8) — TIM8 Break interrupt
123 TIM8_UP (TIM8) — TIM8 Update interrupt
124 TIM8_TRG_CCU (TIM8) — TIM8 Trigger and Commutation interrupts
125 TIM8_CC (TIM8) — TIM8 Capture Compare interrupt
126 TIM9 — TIM9 Global interrupt
127 TIM10 — TIM10 Global interrupt
128 TIM11 — TIM11 Global interrupt
129 TIM12 — TIM12 Global interrupt
130 TIM13 — TIM13 Global interrupt
131 TIM14 — TIM14 Global interrupt
132 TIM15 — TIM15 global interrupt
133 TIM16 — TIM16 global interrupt
134 TIM17 — TIM17 global interrupt
135 TIM18 — TIM18 Global interrupt
136 LPTIM1 — LPTIM1 global interrupt
137 LPTIM2 — LPTIM2 global interrupt
138 LPTIM3 — LPTIM3 global interrupt
139 LPTIM4 — LPTIM4 global interrupt
140 LPTIM5 — LPTIM5 global interrupt
141 ADF1_FLT0 (ADF) — ADF1 filter 0 global interrupt
142 MDF1_FLT0 (MDF1) — MDF global Interrupt for Filter0
143 MDF1_FLT1 (MDF1) — MDF global Interrupt for Filter1
144 MDF1_FLT2 (MDF1) — MDF global Interrupt for Filter2
145 MDF1_FLT3 (MDF1) — MDF global Interrupt for Filter3
146 MDF1_FLT4 (MDF1) — MDF global Interrupt for Filter4
147 MDF1_FLT5 (MDF1) — MDF global Interrupt for Filter5
148 SAI1_A (SAI1) — SAI1 global interrupt A
149 SAI1_B (SAI1) — SAI1 global interrupt B
150 SAI2_A (SAI2) — SAI2 global interrupt A
151 SAI2_global_B (SAI2) — SAI2 global interrupt B
152 SPDIFRX — SPDIFRX global interrupt
153 SPI1 — SPI1 global interrupt A
154 SPI2 — SPI2 global interrupt A
155 SPI3 — SPI3 global interrupt A
156 SPI4 — SPI4 global interrupt A
157 SPI5 — SPI5 global interrupt A
158 SPI6 — SPI6 global interrupt A
159 USART1 — USART1 Global interrupt
160 USART2 — USART2 Global interrupt
161 USART3 — USART3 Global interrupt
162 UART4 — UART4 Global interrupt
163 UART5 — UART5 Global interrupt
164 USART6 — USART6 Global interrupt
165 UART7 — UART7 Global interrupt
166 UART8 — UART8 Global interrupt
167 UART9 — UART9 Global interrupt
168 USART10 — USART10 Global interrupt
169 LPUART1 — LPUART1 global interrupt
170 XSPI1 — XSPI1 global interrupt
171 XSPI2 — XSPI2 global interrupt
172 XSPI3 — XSPI3 global interrupt
173 FMC (FMC1) — FMC global interrupt
174 SDMMC1 — SDMMC1 global interrupt
175 SDMMC2 — SDMMC2 global interrupt
176 UCPD — UCPD global interrupt
177 OTG1 — USB OTG1 HS global interrupt
178 OTG2 — USB OTG2 HS global interrupt
179 ETH1 (ETH) — Ethernet global interrupt
180 FDCAN1_IT0 (FDCAN1) — FDCAN1 interrupt 0
181 FDCAN1_IT1 (FDCAN1) — FDCAN1 interrupt 1
182 FDCAN2_IT0 (FDCAN2) — FDCAN2 interrupt 0
183 FDCAN2_IT1 (FDCAN2) — FDCAN2 interrupt 1
184 FDCAN3_IT0 (FDCAN3) — FDCAN3 interrupt 0
185 FDCAN3_IT1 (FDCAN3) — FDCAN3 interrupt 1
186 FDCAN_CU (FDCAN1) — Clock calibration unit interrupt line(FDCAN1 only)
187 MDIOS — MDIOS global Interrupt
188 DCMI_PSSI (DCMI) — DCMI/PSSI global interrupt
189 WAKEUP_PIN (EXTI) — Wake-up pin interrupts
190 CTI0 (EXTI) — Debug monitor (Cortex-M55 related)
191 CTI1 (EXTI) — Debug monitor (Cortex-M55 related)
193 LTDC_UP (LTDC) — LCD up-layer global interrupt
194 LTDC_UP_ERR (LTDC) — LCD up-layer error interrupt

## Notices in the file
Copyright (c) 2024 STMicroelectronics.
SPDX-License-Identifier: Apache-2.0
Licensed under the Apache License, Version 2.0 (the "License");
you may not use this file except in compliance with the License.
You may obtain a copy of the License at
http://www.apache.org/licenses/LICENSE-2.0
Unless required by applicable law or agreed to in writing, software
distributed under the License is distributed on an "AS IS" BASIS,
WITHOUT WARRANTIES OR CONDITIONS OF ANY KIND, either express or implied.
See the License for the specific language governing permissions and
limitations under the License.
