# STM32G564 register map
File version: 2.0.0
CPU: CM33 r0p4, little endian, MPU, FPU, 4 interrupt priority bits
Registers are 32-bit, read-write, reset 0x0 unless marked. A register's access mark holds for its fields unless they carry their own. Offsets are from the block's base; lines under a group give offsets from that group; [hi:lo] are bit positions; {n}, {i} and the like mark numbered series; 'fields as' and 'values as' point back to an identical list; <NAME> marks a mode.

## Memory map
0x40000000 TIM2 size 0x3E4 — TIM address block description
0x40000400 TIM3 size 0x3E4
0x40001000 TIM6 size 0x30 — TIM address block description
0x40001400 TIM7 size 0x30
0x40001800 TIM9 size 0x60 — TIM9 address block description
0x40001C00 TIM10 size 0x60 — TIM10 address block description
0x40002000 TIM11 size 0x60 — TIM11 address block description
0x40002400 TIM12 size 0x60 — TIM12 address block description
0x40002800 TIM13 size 0x60 — TIM13 address block description
0x40002C00 TIM14 size 0x60 — TIM14 address block description
0x40003000 WWDG size 0xC — WWDG address block description
0x40003400 IWDG size 0x1C — IWDG address block description
0x40003800 SPI2 size 0x54
0x40003C00 SPI3 size 0x54
0x40004400 USART2 size 0x400
0x40004800 USART3 size 0x400
0x40004C00 UART4 size 0x400
0x40005000 UART5 size 0x400
0x40005400 I2C1 size 0x400 — Inter-integrated circuit
0x40005800 I2C2 size 0x400
0x40005C00 I3C1 size 0x400 — Improved inter-integrated circuit
0x40006000 CRS size 0x10 — CRS address block description
0x40006400 UART6 size 0x400
0x40008C00 DTS size 0x30 — DTS address block description
0x4000A000 FDCAN1 size 0x400 — FDCAN register block
0x4000A400 FDCAN2 size 0x400
0x4000A800 FDCAN3 size 0x400
0x4000DC00 UCPD1 size 0x400 — UCPD register block
0x40010000 HRTIM1 size 0x800 — HRTIM address block description
0x40011400 PLAY1 size 0x400 — PLAY register block
0x40012C00 TIM1 size 0x3E4 — TIM address block description
0x40013000 SPI1 size 0x54 — SPI address block description
0x40013400 TIM8 size 0x3E4
0x40013800 USART1 size 0x400 — USART address block description
0x40014000 TIM15 size 0x3E4 — TIM15 address block description
0x40014400 TIM16 size 0x3E4 — TIM16 address block description
0x40014800 TIM17 size 0x3E4 — TIM17 address block description
0x40016000 USB size 0x5C — USB address block description
0x40016400 USBSRAM size 0x40 — USBSRAM address block description
0x40017400 TIM4 size 0x3E4
0x40017800 TIM5 size 0x3E4
0x40020000 GPDMA1 size 0x1000 — GPDMA register block
0x40021000 GPDMA2 size 0x1000
0x40022000 FLASH size 0x400 — FLASH register block
0x40023000 CRC size 0x18 — CRC address block description
0x40023800 CORDIC1 size 0x400 — CORDIC register block
0x40023C00 FMAC1 size 0x400 — FMAC register block
0x40026000 RAMCFG size 0xAC — RAMCFG address block description
0x40030400 ICACHE size 0x400 — ICACHE register block
0x40031400 DCACHE size 0x400 — DCACHE register block
0x40032400 GTZC1_TZSC size 0x400 — GTZC1_TZSC register block
0x40032800 GTZC1_TZIC size 0x400 — GTZC1_TZIC register block
0x40032C00 GTZC1_MPCBB1 size 0x400 — GTZC1_MPCBB1 register block
0x40033000 GTZC1_MPCBB2 size 0x400 — GTZC1_MPCBB2 register block
0x40033400 GTZC1_MPCBB3 size 0x400 — GTZC1_MPCBB3 register block
0x42020000 ADC1 size 0x100 — ADC register block
0x42020100 ADC2 size 0x100
0x42020300 ADCC12 size 0x14 — ADCC address block description
0x42020400 ADC3 size 0x100
0x42020700 ADCC3 size 0x14
0x42021400 DAC1 size 0x3F0 — DAC address block description
0x42021800 DAC2 size 0x3F0
0x42022400 DAC5 size 0x3F0
0x42022800 DAC6 size 0x3F0
0x42022C00 DAC7 size 0x3F0
0x42023000 DAC8 size 0x3F0
0x42023400 DAC9 size 0x3F0
0x42023800 DAC10 size 0x3F0
0x42024400 FMAC2 size 0x400
0x44000400 SBS size 0x178 — SBS address block description
0x44000800 TIM20 size 0x3E4
0x44000C00 TIM26 size 0x30
0x44001000 TIM27 size 0x30
0x44002400 LPUART size 0x30 — LPUART address block description
0x44002800 I2C3 size 0x400
0x44002C00 I2C4 size 0x400
0x44004400 LPTIM1 size 0x38 — LPTIM address block description
0x44005C00 OPAMP1 size 0x400 — OPAMP register block
0x44006000 OPAMP2 size 0x400
0x44006400 OPAMP3 size 0x400
0x44007400 VREFBUF size 0x8 — VREFBUF address block description
0x44007800 RTC size 0x400 — RTC register block
0x44007C00 TAMP size 0x400 — TAMP register block
0x44008400 COMP1 size 0x40 — COMP address block description
0x44008800 COMP2 size 0x40
0x44008C00 COMP3 size 0x40
0x44009000 COMP4 size 0x40
0x44009400 COMP5 size 0x40
0x44009800 COMP6 size 0x40
0x44009C00 COMP7 size 0x40
0x4400A000 COMP8 size 0x40
0x44010000 POSENC1 size 0x3B24 — POSENC register block
0x44014000 POSENC2 size 0x3B24
0x44020800 PWR size 0x400 — PWR register block
0x44020C00 RCC size 0x400 — RCC register block
0x44022000 EXTI size 0x98 — EXTI address block description
0x44026000 DBGMCU size 0x1000 — DBGMCU register block
0x46000000 GPIOA size 0x34 — GPIO address block description
0x46000400 GPIOB size 0x34 — GPIO address block description
0x46000800 GPIOC size 0x34 — GPIO address block description
0x46000C00 GPIOD size 0x34
0x46001000 GPIOE size 0x34 — GPIO address block description
0x46001400 GPIOF size 0x34 — GPIO address block description
0x46001800 GPIOG size 0x34 — GPIO address block description
0x46001C00 GPIOH size 0x34 — GPIO address block description
0x46005000 OTFDEC1 size 0x400 — OTFDEC register bank
0x46006000 AES size 0x400 — AES register block
0x46006400 HASH size 0x400 — HASH register bank
0x46006800 RNG size 0x400 — RNG register block
0x46006C00 SAES size 0x400 — SAES register block
0x46008000 PKA size 0x2000 — PKA register blank and RAM
0x4600DC00 CCB size 0x400 — CCB register block
0x4600F000 DLYB size 0x8 — DLYB address block description
0x47001400 XSPI1 size 0x400 — XSPI register block
0x50000000 TIM2_S size 0x3E4
0x50000400 TIM3_S size 0x3E4
0x50001000 TIM6_S size 0x30
0x50001400 TIM7_S size 0x30
0x50001800 TIM9_S size 0x60
0x50001C00 TIM10_S size 0x60
0x50002000 TIM11_S size 0x60
0x50002400 TIM12_S size 0x60
0x50002800 TIM13_S size 0x60
0x50002C00 TIM14_S size 0x60
0x50003000 WWDG_S size 0xC
0x50003400 IWDG_S size 0x1C
0x50003800 SPI2_S size 0x54
0x50003C00 SPI3_S size 0x54
0x50004400 USART2_S size 0x400
0x50004800 USART3_S size 0x400
0x50004C00 UART4_S size 0x400
0x50005000 UART5_S size 0x400
0x50005400 I2C1_S size 0x400
0x50005800 I2C2_S size 0x400
0x50005C00 I3C1_S size 0x400
0x50006000 CRS_S size 0x10
0x50006400 UART6_S size 0x400
0x50008C00 DTS_S size 0x30
0x5000A000 FDCAN1_S size 0x400
0x5000A400 FDCAN2_S size 0x400
0x5000A800 FDCAN3_S size 0x400
0x5000DC00 UCPD1_S size 0x400
0x50010000 HRTIM1_S size 0x800
0x50011400 PLAY1_S size 0x400
0x50012C00 TIM1_S size 0x3E4
0x50013000 SPI1_S size 0x54
0x50013400 TIM8_S size 0x3E4
0x50013800 USART1_S size 0x400
0x50014000 TIM15_S size 0x3E4
0x50014400 TIM16_S size 0x3E4
0x50014800 TIM17_S size 0x3E4
0x50016000 USB_S size 0x5C
0x50016400 USBSRAM_S size 0x40
0x50017400 TIM4_S size 0x3E4
0x50017800 TIM5_S size 0x3E4
0x50020000 GPDMA1_S size 0x1000
0x50021000 GPDMA2_S size 0x1000
0x50022000 FLASH_S size 0x400
0x50023000 CRC_S size 0x18
0x50023800 CORDIC1_S size 0x400
0x50023C00 FMAC1_S size 0x400
0x50026000 RAMCFG_S size 0xAC
0x50030400 ICACHE_S size 0x400
0x50031400 DCACHE_S size 0x400
0x50032400 GTZC1_TZSC_S size 0x400
0x50032800 GTZC1_TZIC_S size 0x400
0x50032C00 GTZC1_MPCBB1_S size 0x400
0x50033000 GTZC1_MPCBB2_S size 0x400
0x50033400 GTZC1_MPCBB3_S size 0x400
0x52020000 ADC1_S size 0x100
0x52020100 ADC2_S size 0x100
0x52020300 ADCC12_S size 0x14
0x52020400 ADC3_S size 0x100
0x52020700 ADCC3_S size 0x14
0x52021400 DAC1_S size 0x3F0
0x52021800 DAC2_S size 0x3F0
0x52022400 DAC5_S size 0x3F0
0x52022800 DAC6_S size 0x3F0
0x52022C00 DAC7_S size 0x3F0
0x52023000 DAC8_S size 0x3F0
0x52023400 DAC9_S size 0x3F0
0x52023800 DAC10_S size 0x3F0
0x52024400 FMAC2_S size 0x400
0x54000400 SBS_S size 0x178
0x54000800 TIM20_S size 0x3E4
0x54000C00 TIM26_S size 0x30
0x54001000 TIM27_S size 0x30
0x54002400 LPUART_S size 0x30
0x54002800 I2C3_S size 0x400
0x54002C00 I2C4_S size 0x400
0x54004400 LPTIM1_S size 0x38
0x54005C00 OPAMP1_S size 0x400
0x54006000 OPAMP2_S size 0x400
0x54006400 OPAMP3_S size 0x400
0x54007400 VREFBUF_S size 0x8
0x54007800 RTC_S size 0x400
0x54007C00 TAMP_S size 0x400
{0x54008000+0x400*n} COMP{n}_S size 0x40 (n=1..8)
0x54010000 POSENC1_S size 0x3B24
0x54014000 POSENC2_S size 0x3B24
0x54020800 PWR_S size 0x400
0x54020C00 RCC_S size 0x400
0x54022000 EXTI_S size 0x98
0x54026000 DBGMCU_S size 0x1000
0x56000000 GPIOA_S size 0x34
0x56000400 GPIOB_S size 0x34
0x56000800 GPIOC_S size 0x34
0x56000C00 GPIOD_S size 0x34
0x56001000 GPIOE_S size 0x34
0x56001400 GPIOF_S size 0x34
0x56001800 GPIOG_S size 0x34
0x56001C00 GPIOH_S size 0x34
0x56005000 OTFDEC1_S size 0x400
0x56006000 AES_S size 0x400
0x56006400 HASH_S size 0x400
0x56006800 RNG_S size 0x400
0x56006C00 SAES_S size 0x400
0x56008000 PKA_S size 0x2000
0x5600DC00 CCB_S size 0x400
0x5600F000 DLYB_S size 0x8
0x57001400 XSPI1_S size 0x400

## Interrupts
0 WWDG — Window Watchdog interrupt
2 IWDG — Independent watchdog interrupt
4 PWR_PVD_AVD (PWR) — Power Voltage Monitor/Analog Voltage Monitor
5 TAMP — Tamper global interrupts
6 GTZC1 (GTZC1_MPCBB1) — GTZC1 global interrupt
7 FLASH_S — Flash secure global interrupt
8 FLASH — Flash non-secure global interrupt
11 RAMCFG — RAM configuration global interrupt
12 RCC_S — RCC secure global interrupt
13 RCC — RCC non-secure global interrupt
14 ICACHE — Instruction cache global interrupt
15 DCACHE — Data cache global interrupt
17 RTC_S — RTC global secure interrupt
18 RTC — RTC global non-secure interrupts
{n+19} EXTI{n} (EXTI) (n=0..15) — EXTI Line{n} interrupt
{n+35} GPDMA1_CH{n} (GPDMA1) (n=0..7) — GPDMA1 channel {n} global interrupt
43 SAES — Secure AES
44 ADC1 — ADC1 global interrupt
45 DAC1 — DAC1 global interrupt
46 FDCAN1_IT0 (FDCAN1) — FDCAN1 Interrupt 0
47 FDCAN1_IT1 (FDCAN1) — FDCAN1 Interrupt 1
48 TIM1_BRK_TERR_IERR (TIM1) — TIM1 Break/TIM1 Transition error/TIM1 Index error
49 TIM1_UPD (TIM1) — TIM1 Update
50 TIM1_TRGI_COM_DIR_IDX (TIM1) — TIM1 trigger and commutation/TIM1 Direction Change interrupt/TIM1 Index
51 TIM1_CC (TIM1) — TIM1 capture compare interrupt
52 TIM2 — TIM2 global interrupt
53 TIM3 — TIM3 global interrupt
54 TIM4 — TIM4 global interrupt
55 TIM5 — TIM5 global interrupt
56 TIM6 — TIM6 global interrupt
57 TIM7 — TIM7 global interrupt
58 I2C1_EV (I2C1) — I2C1 event interrupt
59 I2C1_ERR (I2C1) — I2C1 error interrupt
60 I2C2_EV (I2C2) — I2C2 event interrupt
61 I2C2_ERR (I2C2) — I2C2 error interrupt
62 SPI1 — SPI1 global interrupt
63 SPI2 — SPI2 global interrupt
64 SPI3 — SPI3 global interrupt
65 USART1 — USART1 global interrupt
66 USART2 — USART2 global interrupt
67 USART3 — USART3 global interrupt
68 UART4 — UART4 global interrupt
69 UART5 — UART5 global interrupt
70 LPUART1 (LPUART) — LPUART1 global interrupt
71 LPTIM1 — LPTIM1 global interrupt OR LPTimer1 AIT through EXTI line
72 TIM8_BRK_TERR_IERR (TIM8) — TIM8 Break/TIM8 Transition error/TIM8 Index error
73 TIM8_UPD (TIM8) — TIM8 Update
74 TIM8_TRGI_COM_DIR_IDX (TIM8) — TIM8 trigger and commutation/TIM8 Direction Change interrupt/TIM8 Index
75 TIM8_CC (TIM8) — TIM8 capture compare interrupt
76 ADC2 — ADC2 global interrupt
77 ADC3 — ADC3 global interrupt
78 TIM15 — TIM15 global interrupt
79 TIM16 — TIM16 global interrupt
80 TIM17 — TIM17 global interrupt
81 USB_DRD_FS (USB) — USB global interrupt (dual role device, full speed)
82 CRS — Clock Recovery System global interrupt
83 UCPD1 — UCPD1 global interrupt
85 XSPI1 — OCTOSPI1 global interrupt
86 TIM9 — TIM9 global interrupt
87 I2C3_EV (I2C3) — I2C3 event interrupt
88 I2C3_ERR (I2C3) — I2C3 error interrupt
92 UART6 — UART6 global interrupt
93 TIM20_BRK_TERR_IERR (TIM20) — TIM20 Break/TIM20 Transition error/TIM20 Index error
94 TIM20_UPD (TIM20) — TIM20 Update
95 TIM20_TRGI_COM_DIR_IDX (TIM20) — TIM20 trigger and commutation/TIM20 Direction Change interrupt/TIM20 Index
96 TIM20_CC (TIM20) — TIM20 capture compare interrupt
97 GPDMA2_CH0 (GPDMA2) — GPDMA2 channel 0 global interrupt
98 GPDMA2_CH1 (GPDMA2) — GPDMA2 channel 1 global interrupt
99 GPDMA2_CH2 (GPDMA2) — GPDMA2 channel 2 global interrupt
100 GPDMA2_CH3 (GPDMA2) — GPDMA2 channe3 global interrupt
101 GPDMA2_CH4 (GPDMA2) — GPDMA2 channel 4 global interrupt
102 GPDMA2_CH5 (GPDMA2) — GPDMA2 channel 5 global interrupt
103 GPDMA2_CH6 (GPDMA2) — GPDMA2 channel 6 global interrupt
104 GPDMA2_CH7 (GPDMA2) — GPDMA2 channel 7 global interrupt
107 FDCAN3_IT0 (FDCAN3) — FDCAN3 Interrupt 0
108 FDCAN3_IT1 (FDCAN3) — FDCAN3 Interrupt 1
111 FMAC2 — FMAC2 interrupt
112 FDCAN2_IT0 (FDCAN2) — FDCAN2 Interrupt 0
113 FDCAN2_IT1 (FDCAN2) — FDCAN2 Interrupt 1
114 CORDIC1 — CORDIC interrupt
115 FMAC1 — FMAC1 interrupt
116 DTS — DTS interrupt OR DTS AIT through EXTI line
117 RNG — RNG global interrupt
118 OTFDEC1 — OTFDEC1 secure global interrupt
119 AES — AES global interrupt
120 HASH — HASH interrupt
121 PKA — PKA global interrupt
122 TIM10 — TIM10 global interrupt
123 TIM12 — TIM12 global interrupt
124 TIM13 — TIM13 global interrupt
125 TIM14 — TIM14 global interrupt
126 I3C1_EV (I3C1) — I3C1 event interrupt
127 I3C1_ERR (I3C1) — I3C1 error interrupt
128 I2C4_EV (I2C4) — I2C4 event interrupt
129 I2C4_ERR (I2C4) — I2C4 error interrupt
136 POSENC1 — POSENC1 global interrupt
137 POSENC2 — POSENC2 global interrupt
138 HRTIM1_M (HRTIM1) — HRtimer1 master interrupt
139 HRTIM1_TIMA (HRTIM1) — HRtimer1 slave1 interrupt
140 HRTIM1_TIMB (HRTIM1) — HRtimer1 slave2 interrupt
141 HRTIM1_TIMC (HRTIM1) — HRtimer1 slave3 interrupt
142 HRTIM1_TIMD (HRTIM1) — HRtimer1 slave4 interrupt
143 HRTIM1_TIME (HRTIM1) — HRtimer1 slave5 interrupt
144 HRTIM1_TIMF (HRTIM1) — HRtimer1 slave6 interrupt
145 HRTIM1_FLT (HRTIM1) — HRtimer1 error interrupt
146 PLAY1_S — PLA global secure interrupt
147 PLAY1 — PLA global non-secure interrupt
{n+147} COMP{n} (n=1..8) — COMP{n} global interrupt
164 DAC2 — DAC2 global interrupt
167 DAC5 — DAC5 global interrupt
168 DAC6 — DAC6 global interrupt
169 DAC7 — DAC7 global interrupt
170 DAC8 — DAC8 global interrupt
171 DAC9 — DAC9 global interrupt
172 DAC10 — DAC10 global interrupt
187 TIM11 — TIM11 global interrupt
188 TIM26 — TIM26 global interrupt
189 TIM27 — TIM27 global interrupt

## Notices in the file
Copyright (c) 2026 STMicroelectronics.
SPDX-License-Identifier: Apache-2.0
Licensed under the Apache License, Version 2.0 (the "License");
you may not use this file except in compliance with the License.
You may obtain a copy of the License at
http://www.apache.org/licenses/LICENSE-2.0
Unless required by applicable law or agreed to in writing, software
distributed under the License is distributed on an "AS IS" BASIS,
WITHOUT WARRANTIES OR CONDITIONS OF ANY KIND, either express or implied.
See the License for the specific language governing permissions and
limitations under the License.
