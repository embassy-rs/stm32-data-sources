# STM32WBA54 register map
File version: 1.0
CPU: CM33 r0p1, little endian, MPU, FPU, 4 interrupt priority bits
Registers are 32-bit, read-write, reset 0x0 unless marked. A register's access mark holds for its fields unless they carry their own. Offsets are from the block's base; lines under a group give offsets from that group; [hi:lo] are bit positions; {n}, {i} and the like mark numbered series; 'fields as' and 'values as' point back to an identical list; <NAME> marks a mode.

## Memory map
0x40000000 TIM2 size 0x3E4 — TIM2 address block description
0x40000400 TIM3 size 0x3E4
0x40002C00 WWDG size 0x400 — System window watchdog
0x40003000 IWDG size 0x400 — Independent watchdog
0x40004400 USART2 size 0x400
0x40005400 I2C size 0x400 — Inter-integrated circuit
0x40009400 LPTIM2 size 0x400
0x40012C00 TIM1 size 0x3E4 — TIM1 address block description
0x40013000 SPI1 size 0x400 — Serial peripheral interface
0x40013800 USART1 size 0x400 — USART register block
0x40014400 TIM16 size 0x3E4 — TIM16 address block description
0x40014800 TIM17 size 0x3E4
0x40020000 GPDMA size 0x1000 — General purpose direct memory access controller
0x40022000 FLASH size 0x400 — Embedded Flash memory
0x40023000 CRC size 0x18 — CRC register block
0x40024000 TSC size 0x400 — Touch sensing controller
0x40026000 RAMCFG size 0x1000 — RAMs configuration controller
0x40030400 ICACHE size 0x400 — Instruction cache
0x40032400 GTZC1_TZSC size 0x400
0x40032800 GTZC1_TZIC size 0x400
0x40032C00 GTZC1_MPCBB1 size 0x400 — GTZC1_MPCBB1 address block description
0x40033000 GTZC1_MPCBB2 size 0x400
0x40034000 GTZC1_MPCBB6 size 0x400 — GTZC1_MPCBB6 address block description
0x42020000 GPIOA size 0x400 — General-purpose I/Os
0x42020400 GPIOB size 0x400 — General-purpose I/Os
0x42020800 GPIOC size 0x400 — General-purpose I/Os
0x42021C00 GPIOH size 0x400 — General-purpose I/Os
0x420C0000 AES size 0x400 — Advanced encryption standard hardware accelerator
0x420C0400 HASH size 0x400 — HASH register block
0x420C0800 RNG size 0x400 — RNG register block
0x420C0C00 SAES size 0x400 — Secure AES coprocessor
0x420C1C00 HSEM size 0x400 — Hardware semaphore
0x420C2000 PKA size 0x2000 — Private key accelerator
0x46000400 SYSCFG size 0x400 — System configuration controller
0x46002000 SPI3 size 0x400
0x46002400 LPUART1 size 0x34 — LPUART address block description
0x46002800 I2C3 size 0x400
0x46004400 LPTIM1 size 0x400 — Low power timer
0x46005400 COMP size 0x400 — Comparator
0x46007800 RTC size 0x400 — Real-time clock
0x46007C00 TAMP size 0x400 — Tamper and backup registers
0x46020800 PWR size 0x400 — Power control
0x46020C00 RCC size 0x400 — Reset and clock control
0x46021000 ADC4 size 0x400 — ADC register block
0x46022000 EXTI size 0x400 — External interrupt/event controller
0x48038000 PTACONV size 0x400 — PTA converter
0x50000000 SEC_TIM2 size 0x3E4
0x50000400 SEC_TIM3 size 0x3E4
0x50002C00 SEC_WWDG size 0x400
0x50003000 SEC_IWDG size 0x400
0x50004400 SEC_USART2 size 0x400
0x50005400 SEC_I2C1 size 0x400
0x50009400 SEC_LPTIM2 size 0x400
0x50012C00 SEC_TIM1 size 0x3E4
0x50013000 SEC_SPI1 size 0x400
0x50013800 SEC_USART1 size 0x400
0x50014400 SEC_TIM16 size 0x3E4
0x50014800 SEC_TIM17 size 0x3E4
0x50020000 SEC_GPDMA size 0x1000
0x50022000 SEC_FLASH size 0x400
0x50023000 SEC_CRC size 0x18
0x50024000 SEC_TSC size 0x400
0x50026000 SEC_RAMCFG size 0x1000
0x50030400 SEC_ICache size 0x400
0x50032400 SEC_GTZC1_TZSC size 0x400
0x50032800 SEC_GTZC1_TZIC size 0x400
0x50032C00 SEC_GTZC1_MPCBB1 size 0x400
0x50033000 SEC_GTZC1_MPCBB2 size 0x400
0x50034000 SEC_GTZC1_MPCBB6 size 0x400
0x52020000 SEC_GPIOA size 0x400
0x52020400 SEC_GPIOB size 0x400
0x52020800 SEC_GPIOC size 0x400
0x52021C00 SEC_GPIOH size 0x400
0x520C0000 SEC_AES size 0x400
0x520C0400 SEC_HASH size 0x400
0x520C0800 SEC_RNG size 0x400
0x520C0C00 SEC_SAES size 0x400
0x520C1C00 SEC_HSEM size 0x400
0x520C2000 SEC_PKA size 0x2000
0x56000400 SEC_SYSCFG size 0x400
0x56002000 SEC_SPI3 size 0x400
0x56002400 SEC_LPUART1 size 0x34
0x56002800 SEC_I2C3 size 0x400
0x56004400 SEC_LPTIM1 size 0x400
0x56005400 SEC_COMP size 0x400
0x56007800 SEC_RTC size 0x400
0x56007C00 SEC_TAMP size 0x400
0x56020800 SEC_PWR size 0x400
0x56020C00 SEC_RCC size 0x400
0x56021000 SEC_ADC4 size 0x400
0x56022000 SEC_EXTI size 0x400
0x58038000 SEC_PTACONV size 0x400
0xE000EE08 DCB size 0x5 — Debug Control Block
0xE0044000 DBGMCU size 0x1000 — DBGMCU address block description

## Interrupts
0 WWDG — Window Watchdog interrupt
1 PDV (EXTI) — Power voltage monitor
2 RTC — RTC non-secure global interrupts
3 RTC_S (RTC) — RTC secure global interrupts
4 TAMP — Tamper global interrupts
5 RAMCFG — RAM configuration global interrupt
6 FLASH — Flash interface non-secure global interrupt,Flash ECC single error correction interrupt
9 RCC — RCC non-secure global interrupt
10 RCC_S (RCC) — RCC Ssecure global interrupt
{n+11} EXTI{n} (EXTI) (n=0..15) — EXTI line{n} interrupt
28 SAES — Secure AES interrupt
{n+29} GPDMA1_CH{n} (GPDMA) (n=0..7) — GPDMA1 channel {n} global interrupt
37 TIM1_BRK_TERR_IERR (TIM1) — TIM1 Break - transition error -index error
38 TIM1_UP (TIM1) — TIM1 Update
39 TIM1_TRG_COM_DIR_IDX (TIM1) — TIM1 Trigger and Commutation - direction change interrupt -index
40 TIM1_CC (TIM1) — TIM1 Capture Compare interrupt
41 TIM2 — TIM2 global interrupt
42 TIM3 — TIM3 global interrupt
43 I2C1_EV (I2C) — I2C1 event interrupt
44 I2C1_ER (I2C) — I2C1 error interrupt
45 SPI1 — SPI1 global interrupt
46 USART1 — USART1 global interrupt
47 USART2 — USART2 global interrupt
48 LPUART1 — LPUART1 global interrupt
49 LPTIM1 — LPTIM1 global interrupt
50 LPTIM2 — LPTIM2 global interrupt
51 TIM16 — TIM16 global interrupt
52 TIM17 — TIM17 global interrupt
54 I2C3_EV (I2C3) — I2C3 event interrupt
55 I2C3_ER (I2C3) — I2C3 error interrupt
57 TSC — TSC global interrupt
58 AES — AES global interrupt
59 RNG — RNG global interrupt
61 HASH — HASH interrupt
62 PKA — PKA global interrupt
63 SPI3 — SPI3 global interrupt
64 ICACHE — Instruction cache global interrupt
65 ADC4 — ADC4 global interrupt
67 WKUP (PWR) — PWR global WKUP pin interrupt
68 HSEM — HSEM non-secure interrupt
69 HSEM_S (HSEM) — HSEM secure interrupt

## Notices in the file
Copyright (c) 2025 STMicroelectronics.
SPDX-License-Identifier: Apache-2.0
Licensed under the Apache License, Version 2.0 (the "License");
you may not use this file except in compliance with the License.
You may obtain a copy of the License at
http://www.apache.org/licenses/LICENSE-2.0
Unless required by applicable law or agreed to in writing, software
distributed under the License is distributed on an "AS IS" BASIS,
WITHOUT WARRANTIES OR CONDITIONS OF ANY KIND, either express or implied.
See the License for the specific language governing permissions and
limitations under the License.
